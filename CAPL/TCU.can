/*@!Encoding:65001*/
includes
{
  
}

variables {
  msTimer tmrTCU;
  msTimer ActTCU;
  
  int currGear=1;
  float rpm;
  int flag = 0;
  float preRpm;
  
  message CAN1::TCU_Gear_Data gearData;
  message CAN1::TCU_NM_Flag P_TCU_NM_Flag;
  message CAN1::TCU_Gear_Data P_TCU_Gear_Data;
}

on timer tmrTCU {
  output(P_TCU_NM_Flag);
  output(P_TCU_Gear_Data);
}

on start {
  currGear = 1;
  rpm = $CAN1::EMS_Engine_Data::EMS_RPM_Data;
  
  $CAN1::TCU_Gear_Data::TCU_GearType = currGear;
  
  setTimerCyclic(tmrTCU, 0, 50);
  $CAN1::TCU::TCU_Gear_Data::TCU_GearState.phys = 0;
  $CAN1::TCU::TCU_Gear_Data::TCU_GearType.phys = 1;
  $CAN1::TCU::TCU_Gear_Data::TCU_Parking_Gear.phys = 0;
  $CAN1::TCU::TCU_NM_Flag::TCU_Flag.phys = 0;
  setTimer(ActTCU, 50);
}

on signal_update CAN1::EMS_Engine_Data::EMS_Brake_ACT {
  if(this == 1) { 
    currGear = 0;
    preRpm =3000;
    flag = 1;
    $CAN1::TCU_Gear_Data::TCU_GearType = currGear;
    $CAN1::TCU_Gear_Data::TCU_Parking_Gear = 1;
    output(P_TCU_Gear_Data);
    cancelTimer(tmrTCU);
  }
}

on message EMS_Engine_Data {
  rpm = this.EMS_RPM_Data;
}

on timer ActTCU {
  $CAN1::TCU_Gear_Data::TCU_Parking_Gear = 0;
  
  if(currGear == 1) {
    if(rpm > 3000) {
      currGear++;
      flag=1;
      preRpm = 1300;
      $CAN1::TCU_Gear_Data::TCU_GearType = currGear;
    }
  }
  else if(currGear == 2) {
    if(rpm < preRpm && rpm <= 1300) {
      currGear--;
      flag = 1;
      preRpm = 4000;
      gearData.TCU_GearType = currGear;
    }
    if(rpm > preRpm && rpm >= 4000) {
      currGear++;
      flag=1;
      preRpm = 2000;
      $CAN1::TCU_Gear_Data::TCU_GearType = currGear;
    }
  }
    else if(currGear == 3) {
    if(rpm < preRpm && rpm <= 2000) {
      currGear--;
      flag = 1;
      preRpm = 5000;
      gearData.TCU_GearType = currGear;
    }
    if(rpm > preRpm && rpm >= 5000) {
      currGear++;
      flag=1;
      preRpm = 2500;
      $CAN1::TCU_Gear_Data::TCU_GearType = currGear;
    }
  }
    else if(currGear == 4) {
    if(rpm < preRpm && rpm <= 2500) {
      currGear--;
      flag = 1;
      preRpm = 6000;
      gearData.TCU_GearType = currGear;
    }
    if(rpm > preRpm && rpm >= 6000) {
      currGear++;
      flag=1;
      preRpm = 3000;
      $CAN1::TCU_Gear_Data::TCU_GearType = currGear;
    }
  }
  else if (currGear==5) {
    if(rpm<preRpm && rpm <= 3000) {
      currGear--;
      flag=1;
      preRpm=8000;
      $CAN1::TCU_Gear_Data::TCU_GearType = currGear;
    }
  }
  else {}
  
  if(!flag) preRpm=rpm;
  
  $CAN1::TCU_Gear_Data::TCU_GearType=currGear;
  flag=0;
  setTimer(ActTCU, 50);
}
