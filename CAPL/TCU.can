/*@!Encoding:65001*/
includes
{
  
}

variables {
  msTimer tmrTCU;
  
  int currGear=1;
  float rpm;
  int flag = 0;
  float preRpm;
  
  message CAN1::TCU_Gear_Data gearData;
  message CAN1::TCU_NM_Flag P_TCU_NM_Flag;
  message CAN1::TCU_Gear_Data P_TCU_Gear_Data;
}

on timer tmrTCU {
  output(P_TCU_NM_Flag);
  output(P_TCU_Gear_Data);
}

on start {
  setTimerCyclic(tmrTCU, 0, 20);
  $CAN1::TCU::TCU_Gear_Data::TCU_GearState.phys = 0;
  $CAN1::TCU::TCU_Gear_Data::TCU_GearType.phys = 0;
  $CAN1::TCU::TCU_Gear_Data::TCU_Parking_Gear.phys = 0;
  $CAN1::TCU::TCU_NM_Flag::TCU_Flag.phys = 0;
}

on signal_update CAN1::EMS_Engine_Data::EMS_Brake_ACT {
  if(this == 1) { 
    cancelTimer(tmrTCU);
    $CAN1::TCU_Gear_Data::TCU_GearType.phys = 0;
    $CAN1::TCU_Gear_Data::TCU_Parking_Gear.phys = 1;
    output(P_TCU_Gear_Data);
  }
}

on message CAN1::EMS_WheelSpd {
  if(this.WheelSpd < 16 && this.WheelSpd > 0) {
    $CAN1::TCU_Gear_Data::TCU_GearType.phys = 1;
  } else if (this.WheelSpd >= 16 && this.WheelSpd < 32) {
    $CAN1::TCU_Gear_Data::TCU_GearType.phys = 2;
  } else if (this.WheelSpd >= 32 && this.WheelSpd < 48) {
    $CAN1::TCU_Gear_Data::TCU_GearType.phys = 3;
  } else if (this.WheelSpd >= 48 && this.WheelSpd < 64) {
    $CAN1::TCU_Gear_Data::TCU_GearType.phys = 4;
  } else if (this.WheelSpd >= 64 && this.WheelSpd <= 80) {
    $CAN1::TCU_Gear_Data::TCU_GearType.phys = 5;
  }
}
