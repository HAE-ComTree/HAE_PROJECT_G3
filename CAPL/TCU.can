/*@!Encoding:65001*/
includes
{
  
}

variables {
  msTimer tmrTCU;
  
  int currGear=1;
  float rpm;
  int flag = 0;
  float preRpm;
  
  message Powertrain::TCU_Gear_Data gearData;
  message Powertrain::TCU_NM_Flag P_TCU_NM_Flag;
  message Powertrain::TCU_Gear_Data P_TCU_Gear_Data;
}

on timer tmrTCU {
  output(P_TCU_NM_Flag);
  output(P_TCU_Gear_Data);
}

on start {
  currGear = 1;
  rpm = $Powertrain::EMS_Engine_Data::EMS_RPM_Data;
  
  $Powertrain::TCU_Gear_Data::TCU_GearType = currGear;
  
  setTimerCyclic(tmrTCU, 0, 50);
  $Powertrain::TCU::TCU_Gear_Data::TCU_GearState.phys = 0;
  $Powertrain::TCU::TCU_Gear_Data::TCU_GearType.phys = 1;
  $Powertrain::TCU::TCU_Gear_Data::TCU_Parking_Gear.phys = 0;
  $Powertrain::TCU::TCU_NM_Flag::TCU_Flag.phys = 0;
  
}

on message Powertrain::EMS_Engine_Data {
  rpm = @sysvar::EMS_Var::EngineRPM;
  if(this.EMS_RPM_Data == 0) {
    currGear=0;
  }
  
  if(currGear == 1) {
    if(rpm > 3000) {
      currGear++;
      flag=1;
      preRpm = 1300;
      $Powertrain::TCU_Gear_Data::TCU_GearType = currGear;
    }
  }
  else if(currGear == 2) {
    if(rpm < preRpm && rpm <= 1300) {
      currGear--;
      flag = 1;
      preRpm = 4000;
      gearData.TCU_GearType = currGear;
    }
    if(rpm > preRpm && rpm >= 4000) {
      currGear++;
      flag=1;
      preRpm = 2000;
      $Powertrain::TCU_Gear_Data::TCU_GearType = currGear;
    }
  }
    else if(currGear == 3) {
    if(rpm < preRpm && rpm <= 2000) {
      currGear--;
      flag = 1;
      preRpm = 5000;
      gearData.TCU_GearType = currGear;
    }
    if(rpm > preRpm && rpm >= 5000) {
      currGear++;
      flag=1;
      preRpm = 2500;
      $Powertrain::TCU_Gear_Data::TCU_GearType = currGear;
    }
  }
    else if(currGear == 4) {
    if(rpm < preRpm && rpm <= 2500) {
      currGear--;
      flag = 1;
      preRpm = 6000;
      gearData.TCU_GearType = currGear;
    }
    if(rpm > preRpm && rpm >= 6000) {
      currGear++;
      flag=1;
      preRpm = 3000;
      $Powertrain::TCU_Gear_Data::TCU_GearType = currGear;
    }
  }
  else if (currGear==5) {
    if(rpm<preRpm && rpm <= 3000) {
      currGear--;
      flag=1;
      preRpm=8000;
      $Powertrain::TCU_Gear_Data::TCU_GearType = currGear;
    }
  }
  else if (currGear == 0) {
    preRpm = 0;
    flag = 1;
    $Powertrain::TCU_Gear_Data::TCU_GearType = currGear;
    cancelTimer(tmrTCU);
  }
  
  if(!flag) preRpm=rpm;
  
  $Powertrain::TCU_Gear_Data::TCU_GearType=currGear;
  flag=0;
}
