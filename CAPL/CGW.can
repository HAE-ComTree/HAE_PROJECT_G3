/*@!Encoding:65001*/
includes
{
  
}

variables
{
  UdpSocket gSocket;
  byte gRxBuf[256];
  byte gTxBuf[256];
  struct myMapData
  {
    dword destDomain;
    dword otherDomainID;
  };
  
  struct myMapData CGWTxMap[long];     // 0
  struct myMapData PCanToCGWMap[long]; // 1
  struct myMapData CCanToCGWMap[long]; // 2
  struct myMapData BCanToCGWMap[long]; // 3
  struct myMapData EthToCGWMap[long]; // 4 key 이더넷 id로 변경
  //struct myMapData TEthToCGWMap[long]; // 5
  
  Ip_Endpoint(192.168.1.34:8010) VCUIpAddr;
  Ip_Endpoint(192.168.1.33:8008) TMUIpAddr;
}

on start
{
  //write("CGW Start");
  MakeMap();
  gSocket = UdpSocket::Open(ip_Endpoint(192.168.1.25:8012));
  gSocket.ReceiveFrom(gRxBuf, elcount(gRxBuf));
}

on preStop
{
  gSocket.Close();
}

void AssignMap(byte source, dword canID, byte ethIDVal, byte destDomainVal)
{
  switch(source)
  {
    case 0:
      CGWTxMap[canID].otherDomainID = ethIDVal;
      CGWTxMap[canID].destDomain = destDomainVal;
      break;
    case 1:
      PCanToCGWMap[canID].otherDomainID = ethIDVal;
      PCanToCGWMap[canID].destDomain = destDomainVal;
      break;
    case 2:
      CCanToCGWMap[canID].otherDomainID = ethIDVal;
      CCanToCGWMap[canID].destDomain = destDomainVal;
      break;
    case 3:
      BCanToCGWMap[canID].otherDomainID = ethIDVal;
      BCanToCGWMap[canID].destDomain = destDomainVal;
      break;
    case 4:
      EthToCGWMap[ethIDVal].otherDomainID = canID;
      EthToCGWMap[ethIDVal].destDomain = destDomainVal;
      break;
    case 5:
      EthToCGWMap[ethIDVal].otherDomainID = canID;
      EthToCGWMap[ethIDVal].destDomain = destDomainVal;
      break;
  }
}

byte MakeDestDomainCode(byte PCan, byte CCan, byte BCan, byte VCU, byte TMU)
{
  byte DestDomain = 0;
  DestDomain = PCan;
  DestDomain = (CCan << 1) | DestDomain;
  DestDomain = (BCan << 2) | DestDomain;
  DestDomain = (VCU << 3) | DestDomain;
  DestDomain = (TMU << 4) | DestDomain;
  return DestDomain;
}

void MakeMap()
{
  //void AssignMap(byte sourceDomain, long canID, byte ethID, byte destDomain)
  //byte MakeDestDomainCode(p-can, c, b, vcu, tmu)
    
  //CGW Sleep/Wake Signal
  AssignMap(0, 0x053, 0, MakeDestDomainCode(1,0,0,0,0));
  AssignMap(0, 0x054, 0, MakeDestDomainCode(1,0,0,0,0));
  AssignMap(0, 0x055, 0, MakeDestDomainCode(1,0,0,0,0));
  AssignMap(0, 0x056, 0, MakeDestDomainCode(0,1,0,0,0));
  AssignMap(0, 0x057, 0, MakeDestDomainCode(0,1,0,0,0));
  AssignMap(0, 0x058, 0, MakeDestDomainCode(0,1,0,0,0));
  AssignMap(0, 0x059, 0, MakeDestDomainCode(0,1,0,0,0));
  AssignMap(0, 0x050, 0, MakeDestDomainCode(0,0,1,0,0));
  AssignMap(0, 0x051, 0, MakeDestDomainCode(0,0,1,0,0));
  AssignMap(0, 0x052, 0, MakeDestDomainCode(0,0,1,0,0));
  
  //P-CAN
  AssignMap(1, 0x100, 4, MakeDestDomainCode(0,1,1,1,0)); //#### sig2 기어 데이터 PD12345
  AssignMap(1, 0x101, 0, MakeDestDomainCode(0,1,1,0,0));
  AssignMap(1, 0x102, 0, MakeDestDomainCode(0,1,0,0,0));
  AssignMap(1, 0x103, 0, MakeDestDomainCode(0,1,1,0,0));
  AssignMap(1, 0x140, 0, MakeDestDomainCode(0,1,1,0,0));
  
  //C-CAN
  //AssignMap(2, 0x210, 0, MakeDestDomainCode(0,0,0,0,0));
  //AssignMap(2, 0x211, 0, MakeDestDomainCode(0,0,0,0,0));
//  AssignMap(2, 0x212, 0, MakeDestDomainCode(0,0,0,0,0));
//  AssignMap(2, 0x213, 0, MakeDestDomainCode(0,0,0,0,0));
  AssignMap(2, 0x214, 0, MakeDestDomainCode(1,0,1,0,0));
  AssignMap(2, 0x215, 0, MakeDestDomainCode(1,0,1,0,0));
  AssignMap(2, 0x216, 0, MakeDestDomainCode(1,0,1,0,0));
  AssignMap(2, 0x217, 0, MakeDestDomainCode(1,0,1,0,0));
  AssignMap(2, 0x218, 0, MakeDestDomainCode(1,0,1,0,0));
  AssignMap(2, 0x219, 0, MakeDestDomainCode(1,0,1,0,0));

  //B-CAN
  AssignMap(3, 0x320, 8, MakeDestDomainCode(0,0,0,1,0));
  AssignMap(3, 0x321, 13,MakeDestDomainCode(0,0,0,1,0));
  AssignMap(3, 0x322, 9, MakeDestDomainCode(0,0,0,1,0));
  AssignMap(3, 0x333, 0, MakeDestDomainCode(0,0,0,0,0));
  AssignMap(3, 0x334, 0, MakeDestDomainCode(0,0,0,0,0));
  AssignMap(3, 0x335, 15,MakeDestDomainCode(0,0,0,0,1));
  AssignMap(3, 0x336, 14,MakeDestDomainCode(0,0,0,0,1));
  AssignMap(3, 0x337, 0, MakeDestDomainCode(0,0,0,0,0));
  AssignMap(3, 0x338, 0, MakeDestDomainCode(0,0,0,0,0));
  AssignMap(3, 0x339, 0, MakeDestDomainCode(0,0,0,0,0));
  AssignMap(3, 0x33A, 0, MakeDestDomainCode(0,1,0,0,0));
  AssignMap(3, 0x33B, 0, MakeDestDomainCode(0,1,0,0,0));

  //Ethernet Domain
  //실제로 쓰이는 것만 보내는 중
  //VCU
  AssignMap(4, 0x3E4, 2, MakeDestDomainCode(0,0,1,0,0)); //EDSS VCU IVI
  AssignMap(4, 0x032, 5, MakeDestDomainCode(0,1,1,0,0)); //안전정차 활성화
  AssignMap(4, 0x131, 16,MakeDestDomainCode(1,0,0,0,0)); //IGN SIG
  
  //TMU
  AssignMap(5, 0x3E6, 1, MakeDestDomainCode(0,0,1,0,0)); //GPS
  AssignMap(5, 0x3E5, 19,MakeDestDomainCode(0,0,1,0,0)); //119
}

byte MakeEthData(message *RxMsg)
{
  if(RxMsg.id == 0x400)
  {
    if(RxMsg.byte(0) == 0 || RxMsg.byte(0) == 1)
    {
      return 1;
    }
    return 0;
  }
  else if(RxMsg.id == 0x100)
  {
    return RxMsg.byte(1);
  }
  return RxMsg.byte(0);
}

byte GetEthID(dword CanID)
{
  byte DomainID = 0;
  DomainID = (CanID >> 8 & 0xF);
  
  if(DomainID == 1)
  {
    return PCanToCGWMap[CanID].otherDomainID;
  }
  else if(DomainID == 2)
  {
    return CCanToCGWMap[CanID].otherDomainID;
  }
  else if(DomainID == 3)
  {
    return BCanToCGWMap[CanID].otherDomainID;
  }
  else
  {
    return 0;
  }
}

void ForwardingMsg(message *RxMsg, byte destDomainVal)//, message *ForwardMsg)
{
  message *TxMsg;
  if((destDomainVal >> 0) & 1 == 1) //Fowarding To P-Can
  {
    TxMsg = RxMsg;
    TxMsg.id = (RxMsg.id & 0xFF) | 0x100;
    TxMsg.can = 1;
    output (TxMsg);
  }
  if((destDomainVal >> 1) & 1 == 1) //Fowarding To C-Can
  {
    TxMsg = RxMsg;
    TxMsg.id = (RxMsg.id & 0xFF) | 0x200;
    TxMsg.can = 2;
    output (TxMsg);
  }
  if((destDomainVal >> 2) & 1 == 1) //Fowarding To B-Can
  {
    TxMsg = RxMsg;
    TxMsg.id = (RxMsg.id & 0xFF) | 0x300;
    TxMsg.can = 3;
    output (TxMsg);
  }
  if((destDomainVal >> 3) & 1 == 1) //Fowarding To Eth Domain VCU
  {
    gTxBuf[0] = GetEthID(RxMsg.id);
    gTxBuf[1] = MakeEthData(RxMsg);
    gSocket.SendTo(VCUIpAddr, gTxBuf, (dword)2);
    gSocket.ReceiveFrom(gRxBuf, elcount(gRxBuf));
  }
  if((destDomainVal >> 4) & 1 == 1) //Fowarding To Eth Domain TMU
  {
    gTxBuf[0] = GetEthID(RxMsg.id);
    gTxBuf[1] = MakeEthData(RxMsg);
    gSocket.SendTo(TMUIpAddr, gTxBuf, (dword)2);
    gSocket.ReceiveFrom(gRxBuf, elcount(gRxBuf));
  }
}

on message can1.*
{
  if(this.dir == Rx)
  {
    if (PCanToCGWMap.containsKey(this.id)){
    ForwardingMsg(this, PCanToCGWMap[this.id].destDomain);
    }
  }
}

on message can2.*
{
  if(this.dir == Rx)
  {
    if (CCanToCGWMap.containsKey(this.id)){
    ForwardingMsg(this, CCanToCGWMap[this.id].destDomain);
    }
  }
}

on message can3.*
{
  if(this.dir == Rx)
  {
    if (BCanToCGWMap.containsKey(this.id)){
    ForwardingMsg(this, BCanToCGWMap[this.id].destDomain);
    }
  }
}

void OnUdpReceiveFrom(UdpSocket socket, long result, IP_Endpoint remoteEndpoint, byte buffer[], dword size)
{
  if(result == 0)
  {
    TxCanMessage(buffer);
  }
  gSocket.ReceiveFrom(gRxBuf, elcount(gRxBuf));
}

void TxCanMessage(byte buffer[])
{
  message * TxMessage;
  if(buffer[0] == 1)
  {
    //21 ID1 lat8 long8 ori4
    int i = 0, j = 0;
    TxMessage.id = EthToCGWMap[buffer[0]].otherDomainID;
    for(i = 0; i < 8; i++)
    {
      TxMessage.dlc = 8;
      TxMessage.byte(i) = buffer[i+1];
    }
    for(i = 0; i < 8; i++)
    {
      TxMessage.dlc = 8;
      TxMessage.byte(i) = buffer[i+9];
    }
    for(i = 0; i < 4; i++)
    {
      TxMessage.dlc = 4;

    }
    TxMessage.byte(0) = buffer[1];
    ForwardingMsg(TxMessage, EthToCGWMap[buffer[0]].destDomain);
  }
  else
  {
    TxMessage.id = EthToCGWMap[buffer[0]].otherDomainID;
    TxMessage.dlc = 1;
    TxMessage.byte(0) = buffer[1];
    ForwardingMsg(TxMessage, EthToCGWMap[buffer[0]].destDomain);
  }
}

////////////////////////////////////////////////////////test////////////////////////////////////////////////////
//on key 'v'
//{
//  gTxBuf[0] = 4;
//  gTxBuf[1] = 1;
//  gSocket.SendTo(Ip_Endpoint(192.168.1.34:8010), gTxBuf, strlen(gTxBuf));
//  gSocket.ReceiveFrom(gRxBuf, elcount(gRxBuf));
//}

//on key 't'
//{
//  gTxBuf[0] = 4;
//  gTxBuf[1] = 1;
//  gSocket.SendTo(Ip_Endpoint(192.168.1.33:8008), gTxBuf, strlen(gTxBuf));
//  gTxBuf[0] = 5;
//  gTxBuf[1] = 15;
//  gSocket.SendTo(Ip_Endpoint(192.168.1.33:8008), gTxBuf, strlen(gTxBuf));
//  gSocket.ReceiveFrom(gRxBuf, elcount(gRxBuf));
//}

//on key '1'
//{
//  message P_CANv.0x101 myMsg1;
//  myMsg1.dlc = 2;
//  myMsg1.byte(0) = 1;
//  myMsg1.byte(1) = 1;
//  output (myMsg1);
//}

//on key '2'
//{
//  message C_CANv.0x102 myMsg1;
//  myMsg1.dlc = 2;
//  myMsg1.byte(0) = 0xCB;
//  myMsg1.byte(1) = 22;
//  output (myMsg1);
//}

//on key '3'
//{
//  message P_CANv.0x103 myMsg1;
//  myMsg1.dlc = 2;
//  myMsg1.byte(0) = 0xCB;
//  myMsg1.byte(1) = 55;
//  output (myMsg1);
//}