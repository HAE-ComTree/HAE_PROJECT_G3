/*@!Encoding:65001*/

includes
{
  
}

variables {
  float gearratio[6] = {0, 4.639, 2.826, 1.841, 1.386, 1.000};  //기어비
  int currGear = 1; //현재 기어
  
  const float finalDriverRatio = 3.909;
  const int tireWidth = 240;
  const int aspectRatio = 50;
  const int inchOfWheel = 18;
  
  float rpm = 0;
  int gearIndex = 1;
  
  message EMS_WheelSpd P_EMS_WheelSpd;
  message CAN1::EMS_Engine_Data engMsg;
  message CAN1::EMS_NM_Flag P_EMS_NM_Flag;
  message CAN1::EMS_Engine_Data P_EMS_Engine_Data;
  
  msTimer tmrEMS;
  
  /*-----------------------------------------------------------------------------*/

  int WheelSpd;
  int LaneFlag; //LaneFlag = 1; 이면 차선이동할때 차량 속도 변화(초기 속도 80km)
  int StopFlag; //StopFlag = 1; 이면 차량감소 로직시작(~~0km 될떄까지) 몇초동안 감소할지는 이소혜 책임이랑 상의필요
  int WaitFlag;
  
  
  int steps;               // 감속 단계 수
  
  /*-----------------------------------------------------------------------------*/
  
  int IGN1;
  
  /*-----------------------------------------------------------------------------*/
  msTimer StopDcreaseTimer; 
  msTimer StartIncreaseTimer; 
  msTimer LaneChangeDecreaseTimer;
  msTimer EMS_CAL; // 10ms timer;
  
  /*-----------------------------------------------------------------------------*/

}

on message VCU_IGN1
{
  IGN1 = this.IGN_State;
}

on timer StartIncreaseTimer
{
  if( IGN1 == 1)
  {
    if (WheelSpd < 80)
    {
        WheelSpd += steps;
        if (WheelSpd >= 80) 
      {
          WheelSpd = 80;
          cancelTimer(StartIncreaseTimer);
        }
    } 
  }
}

on timer LaneChangeDecreaseTimer
{
  if(IGN1 == 1 && LaneFlag == 1)
  {
    if (WheelSpd <= 80)
    {
        WheelSpd -= steps;
        if (WheelSpd >= 70) 
      {
          WheelSpd = 70;
          cancelTimer(LaneChangeDecreaseTimer);
        }
    } 
  }
}

on timer StopDcreaseTimer
{
  if(IGN1 == 1 && StopFlag == 1)
  {
    if (WheelSpd >= 70)
    {
        WheelSpd -= steps;
        if (WheelSpd <= 0) 
      {
          WheelSpd = 0;
        $CAN1::EMS_Engine_Data::EMS_Brake_ACT = 1;
          cancelTimer(StopDcreaseTimer);
        }
    } 
  }
}



on start {
  $CAN1::EMS_Engine_Data::EMS_RPM_Data = 0;
  currGear = 1;

  setTimerCyclic(tmrEMS, 0, 10); // 10ms 주기로 송신
  
  $CAN1::EMS_NM_Flag::EMS_Flag.phys = 0;
  $CAN1::EMS_Engine_Data::EMS_RPM_Data.phys = 10;
  $CAN1::EMS_Engine_Data::EMS_Accel_ACT.phys = 0;
  $CAN1::EMS_Engine_Data::EMS_Brake_ACT.phys = 0;
  $CAN1::EMS_Engine_Data::EMS_Tq_Data.phys = 0;
  
  /*-----------------------------------------------------------------------------*/
  
  // SW detected
    LaneFlag = 0;
    StopFlag = 0;   
    WaitFlag = 0;
  
  /*-----------------------------------------------------------------------------*/
  
    setTimerCyclic(StartIncreaseTimer,0,100); // 100ms Increase
    setTimerCyclic(LaneChangeDecreaseTimer,0,500); // 500ms LaneChange Decrease
    setTimerCyclic(StopDcreaseTimer,0,250); // 250 ms Stop Decrease
    setTimerCyclic(EMS_CAL,0,10);

  /*-----------------------------------------------------------------------------*/
  
  IGN1 = 0;
  steps = 1;
  WheelSpd = 0;
}

on timer tmrEMS {
  output(P_EMS_NM_Flag);
  output(P_EMS_Engine_Data);
  
  P_EMS_WheelSpd.WheelSpd.phys = WheelSpd;
  output(P_EMS_WheelSpd);
}

on timer EMS_CAL
{
  gearIndex = currGear;
  
  // gearIndex 안전 범위
  if(gearIndex < 1) gearIndex=1;
  if(gearIndex > 5) gearIndex=5;

  // rpm 계산
  rpm = (WheelSpd*gearratio[gearIndex]*finalDriverRatio*1000000)/(3.78*tireWidth*aspectRatio+4800*inchOfWheel);
  $CAN1::EMS_Engine_Data::EMS_RPM_Data = rpm;
}


on message CAN1::TCU_Gear_Data {
  currGear = this.TCU_GearType;
}

on message GW_SSC_CmdSta
{
  if(this.SCC_LanrCmd.phys == 1) LaneFlag = 1;
  if(this.SCC_StopStaSig.phys == 1) StopFlag = 1;
  if(this.SCC_WaitSta.phys == 1) WaitFlag = 1;
}


on message GW_BCM_WheelSpd_FL //50ms EMS로 Tx해줄 예정
{
  WheelSpd = this.WheelSpd_FL.phys;
}
