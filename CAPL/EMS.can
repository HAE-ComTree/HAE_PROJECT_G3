/*@!Encoding:65001*/


includes
{
  
}

variables {
  msTimer tmrEMS;
  float gearratio[6] = {0, 4.639, 2.826, 1.841, 1.386, 1.000};  //기어비
  int currGear = 1; //현재 기어
  
  const float finalDriverRatio = 3.909;
  
  int speed = 0;
  int gearIndex = 1;
  
  message Powertrain::EMS_Engine_Data engMsg;
  message Powertrain::EMS_NM_Flag P_EMS_NM_Flag;
  message Powertrain::EMS_Engine_Data P_EMS_Engine_Data;
}

on start {
  $Powertrain::EMS_Engine_Data::EMS_RPM_Data = 0;
  currGear = 1;

  setTimerCyclic(tmrEMS, 0, 50); // 100ms 주기로 송신
  $Powertrain::EMS_NM_Flag::EMS_Flag.phys = 0;
  $Powertrain::EMS_Engine_Data::EMS_RPM_Data.phys = 1100;
  $Powertrain::EMS_Engine_Data::EMS_Accel_ACT.phys = 0;
  $Powertrain::EMS_Engine_Data::EMS_Brake_ACT.phys = 0;
  $Powertrain::EMS_Engine_Data::EMS_Tq_Data.phys = 0;
}

on timer tmrEMS {
  output(P_EMS_NM_Flag);
  output(P_EMS_Engine_Data);
}

on message GW_BCM_WheelSpd_FL {
  @sysvar::EMS_Var::speed_chk = this.WheelSpd_FL;
  gearIndex = currGear;  // gear=1 => index=0
  
  // gearIndex 안전 범위
  if(gearIndex < 1) gearIndex=1;
  if(gearIndex > 5) gearIndex=5;

  // rpm 계산
  @sysvar::EMS_Var::EngineRPM = (@sysvar::EMS_Var::speed_chk*gearratio[gearIndex]*finalDriverRatio*1000000)/(3.78*240*50+4800*18);
  $Powertrain::EMS_Engine_Data::EMS_RPM_Data = @sysvar::EMS_Var::EngineRPM;
  
  if(this.WheelSpd_FL==0) {
    $Powertrain::EMS_Engine_Data::EMS_RPM_Data = 0;
  }

  //write("EMS => speed=%.1f km/h, gear=%d, rpm=%.1f", @sysvar::EMS_Var::speed_chk, currGear, @sysvar::EMS_Var::EngineRPM);
}

on message Powertrain::TCU_Gear_Data {
  currGear = this.TCU_GearType;
}
