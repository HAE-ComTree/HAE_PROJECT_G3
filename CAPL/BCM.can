/*@!Encoding:65001*/
includes
{
  
}

/*@!Encoding:949*/

variables
{   
    // TX 메시지
    message BCM_NM_Flag           b_BCM_NM_Flag;
    message BCM_EDSS_SW_STATE     b_BCM_EDSS_SW_STATE;  int SW_STATE1; int SW_STATE2;
    message BCM_Wheel_Speed_FL    b_BCM_Wheel_Speed_FL; int Speed_FL;
    message BCM_Wheel_Speed_FR    b_BCM_Wheel_Speed_FR; int Speed_FR;
    message BCM_Wheel_Speed_RL    b_BCM_Wheel_Speed_RL; int Speed_RL;
    message BCM_Wheel_Speed_RR    b_BCM_Wheel_Speed_RR; int Speed_RR;
    message BCM_EDSS_CSW          b_BCM_EDSS_CSW;       int EDSS_CSW;
    message BCM_Seat              b_BCM_Seat;           int Seat_FL; int Seat_FR; int Seat_RL; int Seat_RR;
    message BCM_AirBag_state      b_BCM_AirBag_state;   int AirBag_state;
    message BCM_AirBag_Pos        b_BCM_AirBag_Pos;     int AirBag_Pos;
    message BCM_Steering_Holding  b_BCM_Steering_Holding;int Steering_Holding; 
    message BCM_Steering_Pos      b_BCM_Steering_Pos;    int Steering_Pos;
  
    int NM_flag;
    int IGN1_flag;
    //int SysIGN1sta;
    int Wakeup;
  
    msTimer BCMMessageTimer;      // 송신용 타이머
  
    msTimer wheelspdIncrease;     // 초기 속도를 위한 타이머
    int currentValue;
    int step;
    int wheelSpd;
}

on timer BCMMessageTimer
{ 
  output(b_BCM_NM_Flag);
  output(b_BCM_EDSS_SW_STATE);

  b_BCM_Wheel_Speed_FL.Wheel_Speed_FL.phys = currentValue;
  output(b_BCM_Wheel_Speed_FL);
  
  
  output(b_BCM_Wheel_Speed_FR);
  output(b_BCM_Wheel_Speed_RL);
  output(b_BCM_Wheel_Speed_RR);
  output(b_BCM_EDSS_CSW);
  output(b_BCM_Seat);
  output(b_BCM_AirBag_state);
  output(b_BCM_AirBag_Pos);
  output(b_BCM_Steering_Holding);
  output(b_BCM_Steering_Pos);
}

on timer wheelspdIncrease
{
  if(IGN1_flag == 1)
  {
    if(currentValue < 80)
    {
       currentValue += step;
      if(currentValue > 80)
      {
        currentValue = 80;
        cancelTimer(wheelspdIncrease);
      }
    }
    setTimer(wheelspdIncrease, 100);
  }
  else{
    setTimer(wheelspdIncrease, 100); 
  }
    
  if( currentValue == 80)
  {
    cancelTimer(wheelspdIncrease);
  }
}

void wheelSpdInit()
{
  wheelSpd = 0;
  step = 80/50;
  currentValue = 0;
  setTimer(wheelspdIncrease, 100);
}


/* GW_NM_BCM 메시지 핸들러 */
on message GW_NM_BCM
{
    if (this.NmSleepCmd_BCM == 0) 
    {
        NM_flag = 0; 
    }
    else if (this.NmSleepCmd_BCM == 1)
    {
        NM_flag = 1; 
    }

    checkWakeupCondition();
}

/* VCU_IGN1 메시지 핸들러 */
/*
on message VCU_IGN1
{
    if (this.IGN_State == 0) 
    {
        IGN1_flag = 0;
    }
    else if (this.IGN_State == 1)
    {
        IGN1_flag = 1; 
    }

    checkWakeupCondition();
}*/

/* Wakeup 상태 확인 함수 */
void checkWakeupCondition()
{
    if (IGN1_flag == 1 && NM_flag == 1) 
    {
        if (Wakeup == 0) // Wakeup이 처음으로 1이 되었을 때
        {
            Wakeup = 1;
            b_BCM_NM_Flag.NmSleepFlag_BCM.phys = 1;
        }
    }
    else 
    {
        if (Wakeup == 1) // Wakeup이 0으로 변경될 때
        {
            Wakeup = 0;
            b_BCM_NM_Flag.NmSleepFlag_BCM.phys = 0;
        }
    }
}

/* 초기화 */
on start
{   
    @sysvar::IGN::sv_IGN=0;
    @sysvar::BCM::sv_EDSS_Driver_On_Off = 0;
    @sysvar::BCM::sv_EDSS_Passenger_On_Off = 0;
    @sysvar::BCM::sv_Wheel_Speed_FL = 0;
    @sysvar::BCM::sv_Wheel_Speed_FR = 0;
    @sysvar::BCM::sv_Wheel_Speed_RL = 0;
    @sysvar::BCM::sv_Wheel_Speed_RR = 0;
    @sysvar::BCM::sv_BCM_EDSS_CANCEL_SW = 0;
    @sysvar::BCM::sv_Seat_FL = 0;
    @sysvar::BCM::sv_Seat_FR = 0;
    @sysvar::BCM::sv_Seat_RL = 0;
    @sysvar::BCM::sv_Seat_RR = 0;
    @sysvar::BCM::sv_AirBag_state = 0;
    @sysvar::BCM::sv_AirBag_Pos = 0;
    @sysvar::BCM::sv_Str_Hold = 0;
    @sysvar::BCM::sv_Str_Pos = 0;
    
    b_BCM_NM_Flag.NmSleepFlag_BCM.phys = 0;
  
    b_BCM_EDSS_SW_STATE.EDSS_Driver_On_Off.phys = 0; SW_STATE1 = 0;
    b_BCM_EDSS_SW_STATE.EDSS_Passenger_On_Off.phys = 0; SW_STATE2 = 0; 
    b_BCM_Wheel_Speed_FL.Wheel_Speed_FL.phys = 0; Speed_FL = 0; 
    b_BCM_Wheel_Speed_FR.Wheel_Speed_FR.phys = 0; Speed_FR = 0;
    b_BCM_Wheel_Speed_RL.Wheel_Speed_RL.phys = 0; Speed_RL = 0;
    b_BCM_Wheel_Speed_RR.Wheel_Speed_RR.phys = 0; Speed_RR = 0; 
    b_BCM_EDSS_CSW.BCM_EDSS_CANCEL_SW.phys = 0; EDSS_CSW = 0; 
    b_BCM_Seat.Seat_FL.phys = 0; Seat_FL = 0; Seat_FR = 0; Seat_RL = 0; Seat_RR = 0; 
    b_BCM_AirBag_state.AirBag_state.phys = 0; AirBag_state = 0; 
    b_BCM_AirBag_Pos.AirBag_Pos.phys = 0; AirBag_Pos = 0; 
    b_BCM_Steering_Holding.Str_Hold.phys = 0; Steering_Holding = 0; 
    b_BCM_Steering_Pos.Str_Pos.phys = 0; Steering_Pos = 0; 
  
    setTimerCyclic(BCMMessageTimer, 0, 100); // 100ms 주기로 송신
  
    wheelSpdInit();
  
    NM_flag = 0;
    IGN1_flag = 0;
    Wakeup = 0;
    
}

on sysvar sysvar::IGN::sv_IGN 
{   
    IGN1_flag = @this;
}

//시스템 변수
on sysvar sysvar::BCM::sv_EDSS_Driver_On_Off {
    SW_STATE1 = @this;
    b_BCM_EDSS_SW_STATE.EDSS_Driver_On_Off.phys = SW_STATE1; 
}

on sysvar sysvar::BCM::sv_EDSS_Passenger_On_Off {
    SW_STATE2 = @this;
    b_BCM_EDSS_SW_STATE.EDSS_Passenger_On_Off.phys = SW_STATE2; 
}

on sysvar sysvar::BCM::sv_Wheel_Speed_FL {
    Speed_FL = @this;
    b_BCM_Wheel_Speed_FL.Wheel_Speed_FL.phys = Speed_FL; 
}

on sysvar sysvar::BCM::sv_Wheel_Speed_FR {
    Speed_FR = @this;
    b_BCM_Wheel_Speed_FR.Wheel_Speed_FR.phys = Speed_FR; 
}

on sysvar sysvar::BCM::sv_Wheel_Speed_RL {
    Speed_RL = @this;
    b_BCM_Wheel_Speed_RL.Wheel_Speed_RL.phys = Speed_RL; 
}

on sysvar sysvar::BCM::sv_Wheel_Speed_RR {
    Speed_RR = @this;
    b_BCM_Wheel_Speed_RR.Wheel_Speed_RR.phys = Speed_RR; 
}

on sysvar sysvar::BCM::sv_BCM_EDSS_CANCEL_SW {
    EDSS_CSW = @this;
    b_BCM_EDSS_CSW.BCM_EDSS_CANCEL_SW.phys = EDSS_CSW; 
}

on sysvar sysvar::BCM::sv_Seat_FL {
    Seat_FL = @this;
    b_BCM_Seat.Seat_FL.phys = Seat_FL; 
}

on sysvar sysvar::BCM::sv_Seat_FR {
    Seat_FR = @this;
    b_BCM_Seat.Seat_FR.phys = Seat_FR; 
}

on sysvar sysvar::BCM::sv_Seat_RL {
    Seat_RL = @this;
    b_BCM_Seat.Seat_RL.phys = Seat_RL; 
}

on sysvar sysvar::BCM::sv_Seat_RR {
    Seat_RR = @this;
    b_BCM_Seat.Seat_RR.phys = Seat_RR; 
}

on sysvar sysvar::BCM::sv_AirBag_state {
    AirBag_state = @this;
    b_BCM_AirBag_state.AirBag_state.phys = AirBag_state; 
}

on sysvar sysvar::BCM::sv_AirBag_Pos {
    AirBag_Pos = @this;
    b_BCM_AirBag_Pos.AirBag_Pos.phys = AirBag_Pos; 
}

on sysvar sysvar::BCM::sv_Str_Hold {
    Steering_Holding = @this;
    b_BCM_Steering_Holding.Str_Hold.phys = Steering_Holding; 
}

on sysvar sysvar::BCM::sv_Str_Pos {
    Steering_Pos = @this;
    b_BCM_Steering_Pos.Str_Pos.phys = Steering_Pos; 
}