/*@!Encoding:65001*/
includes
{
  
}

/*@!Encoding:949*/

variables
{   //연습용 
    message VCU_IVI_Msg           b_VCU_IVI_Msg; int a; int b;
    int flag;
  
  
    // TX 메시지
    message BCM_NM_Flag           b_BCM_NM_Flag;
    message BCM_5s                b_BCM_5s;
    message BCM_EDSS_SW_STATE     b_BCM_EDSS_SW_STATE;  int SW_STATE1; int SW_STATE2;
    message BCM_Wheel_Speed_FL    b_BCM_Wheel_Speed_FL; int Speed_FL;
    message BCM_Wheel_Speed_FR    b_BCM_Wheel_Speed_FR; int Speed_FR;
    message BCM_Wheel_Speed_RL    b_BCM_Wheel_Speed_RL; int Speed_RL;
    message BCM_Wheel_Speed_RR    b_BCM_Wheel_Speed_RR; int Speed_RR;
    message BCM_EDSS_CSW          b_BCM_EDSS_CSW;       int EDSS_CSW;
    message BCM_Seat              b_BCM_Seat;           int Seat_FL; int Seat_FR; int Seat_RL; int Seat_RR;
    message BCM_AirBag_state      b_BCM_AirBag_state;   int AirBag_state;
    message BCM_AirBag_Pos        b_BCM_AirBag_Pos;     int AirBag_Pos;
    message BCM_Steering_Holding  b_BCM_Steering_Holding;int Steering_Holding; 
    message BCM_Steering_Pos      b_BCM_Steering_Pos;    int Steering_Pos;
    
    message BCM_Rear_Vehicle_State b_BCM_Rear_Vehicle_State; int Rear_Vehicle_State;
    message BCM_Side_Road_State   b_BCM_Side_Road_State; int Side_Road_State;
    msTimer moving;
  
    int NM_flag = 0;
    int IGN1_flag = 0;
    int Wakeup = 0;
  
    msTimer BCMMessageTimer;      // 송신용 타이머
  
    // 차속을 위한 타이머
    msTimer wheelspdIncrease;     
    int currentValue;
    int step;
    int wheelSpd;
  
    //5초 카운트
    int BCM_cnt5s;
    msTimer EDSS_5sCnt;
    int EDSS_cnt;
    int count5s;
}

on timer BCMMessageTimer
{ 
  //연습용
  output(b_VCU_IVI_Msg);
  
  
  
  
  output(b_BCM_NM_Flag);
  output(b_BCM_EDSS_SW_STATE);
  
  //차속
  b_BCM_Wheel_Speed_FL.Wheel_Speed_FL.phys = currentValue;
  output(b_BCM_Wheel_Speed_FL);
  
  //5초 카운트
  b_BCM_5s.Count_5s.phys = BCM_cnt5s;
  output(b_BCM_5s); 

  output(b_BCM_Wheel_Speed_FR);
  output(b_BCM_Wheel_Speed_RL);
  output(b_BCM_Wheel_Speed_RR);
  output(b_BCM_EDSS_CSW);
  output(b_BCM_Seat);
  output(b_BCM_AirBag_state);
  output(b_BCM_AirBag_Pos);
  output(b_BCM_Steering_Holding);
  output(b_BCM_Steering_Pos);
  
  output(b_BCM_Rear_Vehicle_State);
  output(b_BCM_Side_Road_State);
}

on timer wheelspdIncrease
{
  if(IGN1_flag == 1)
  {
    if(currentValue < 80)
    {
       currentValue += step;
      if(currentValue > 80)
      {
        currentValue = 80;
        cancelTimer(wheelspdIncrease);
      }
    }
    setTimer(wheelspdIncrease, 100);
  }
  else{
    setTimer(wheelspdIncrease, 100); 
  }
    
  if( currentValue == 80)
  {
    cancelTimer(wheelspdIncrease);
  }
}

on timer EDSS_5sCnt
{
  if(count5s < 5) {  
    count5s++;
    BCM_cnt5s = 0;
    @sysvar::BCM::sv_Count_5s = count5s;
    setTimer(EDSS_5sCnt, 1000);
  }
  else
  { 
    BCM_cnt5s = 1;
    count5s = 0;
    setControlVisibility("Cluster","count_5s", 0);
    setControlVisibility("Cluster","count_5s_message",0); 
  }
}


void wheelSpdInit()
{
  wheelSpd = 0;
  step = 80/50;
  currentValue = 0;
  setTimer(wheelspdIncrease, 100);
}


/* GW_NM_BCM 메시지 핸들러 */
on message GW_NM_BCM
{
    if (this.NmSleepCmd_BCM == 0) 
    {
        NM_flag = 0; 
    }
    else if (this.NmSleepCmd_BCM == 1)
    {
        NM_flag = 1; 
    }

    checkWakeupCondition();
}

/* VCU_IGN1 메시지 핸들러 */
/*
on message VCU_IGN1
{
    if (this.IGN_State == 0) 
    {
        IGN1_flag = 0;
    }
    else if (this.IGN_State == 1)
    {
        IGN1_flag = 1; 
    }

    checkWakeupCondition();
}*/

/* Wakeup 상태 확인 함수 */
void checkWakeupCondition()
{
    if (IGN1_flag == 1 && NM_flag == 1) 
    {
        if (Wakeup == 0) // Wakeup이 처음으로 1이 되었을 때
        {
            Wakeup = 1;
            b_BCM_NM_Flag.NmSleepFlag_BCM.phys = 1;
        }
    }
    else 
    {
        if (Wakeup == 1) // Wakeup이 0으로 변경될 때
        {
            Wakeup = 0;
            b_BCM_NM_Flag.NmSleepFlag_BCM.phys = 0;
        }
    }
}

/* 초기화 */
on start
{   
    //연습용
    @sysvar::BCM::pra_edss_act = 0;
    @sysvar::BCM::pra_ecall_req = 0;
    b_VCU_IVI_Msg.EDSS_Act.phys = 0; a=0;
    b_VCU_IVI_Msg.ECall_Req.phys = 0; b=0;
  
  
  
    @sysvar::IGN::sv_IGN=0;
    @sysvar::BCM::sv_EDSS_Driver_On_Off = 0;
    @sysvar::BCM::sv_EDSS_Passenger_On_Off = 0;
    @sysvar::BCM::sv_Wheel_Speed_FL = 0;
    @sysvar::BCM::sv_Wheel_Speed_FR = 0;
    @sysvar::BCM::sv_Wheel_Speed_RL = 0;
    @sysvar::BCM::sv_Wheel_Speed_RR = 0;
    @sysvar::BCM::sv_BCM_EDSS_CANCEL_SW = 0;
    @sysvar::BCM::sv_Seat_FL = 0;
    @sysvar::BCM::sv_Seat_FR = 0;
    @sysvar::BCM::sv_Seat_RL = 0;
    @sysvar::BCM::sv_Seat_RR = 0;
    @sysvar::BCM::sv_AirBag_state = 0;
    @sysvar::BCM::sv_AirBag_Pos = 0;
    @sysvar::BCM::sv_Str_Hold = 0;
    @sysvar::BCM::sv_Str_Pos = 0;
  
    @sysvar::BCM::sv_Rear_Vehicle_state = 0;
    @sysvar::BCM::sv_Side_Road_State = 0;
  
    b_BCM_NM_Flag.NmSleepFlag_BCM.phys = 0;
  
    b_BCM_5s.Count_5s.phys = 0; EDSS_cnt = 0; count5s = 0; BCM_cnt5s = 0; //setTimer(EDSS_5sCnt,1000);
// 5초 카운트 초기화
    b_BCM_EDSS_SW_STATE.EDSS_Driver_On_Off.phys = 0; SW_STATE1 = 0;
    b_BCM_EDSS_SW_STATE.EDSS_Passenger_On_Off.phys = 0; SW_STATE2 = 0; 
    b_BCM_Wheel_Speed_FL.Wheel_Speed_FL.phys = 0; Speed_FL = 0; 
    b_BCM_Wheel_Speed_FR.Wheel_Speed_FR.phys = 0; Speed_FR = 0;
    b_BCM_Wheel_Speed_RL.Wheel_Speed_RL.phys = 0; Speed_RL = 0;
    b_BCM_Wheel_Speed_RR.Wheel_Speed_RR.phys = 0; Speed_RR = 0; 
    b_BCM_EDSS_CSW.BCM_EDSS_CANCEL_SW.phys = 0; EDSS_CSW = 0; 
    b_BCM_Seat.Seat_FL.phys = 0; Seat_FL = 0; Seat_FR = 0; Seat_RL = 0; Seat_RR = 0; 
    b_BCM_AirBag_state.AirBag_state.phys = 0; AirBag_state = 0; 
    b_BCM_AirBag_Pos.AirBag_Pos.phys = 0; AirBag_Pos = 0; 
    b_BCM_Steering_Holding.Str_Hold.phys = 0; Steering_Holding = 0; 
    b_BCM_Steering_Pos.Str_Pos.phys = 0; Steering_Pos = 0; 
  
    b_BCM_Rear_Vehicle_State.Rear_Vehicle_state.phys = 0; Rear_Vehicle_State = 0;
    b_BCM_Side_Road_State.Side_Road_State.phys = 0; Side_Road_State = 0;
  
    setTimerCyclic(BCMMessageTimer, 0, 100); // 100ms 주기로 송신
    setTimerCyclic(moving, 0, 150); flag=0;
  
    wheelSpdInit();
  
    NM_flag = 0;
    IGN1_flag = 0;
    Wakeup = 0;
    
}

on sysvar sysvar::IGN::sv_IGN 
{   
    IGN1_flag = @this;
}

//시스템 변수
on sysvar sysvar::BCM::sv_EDSS_Driver_On_Off {
    SW_STATE1 = @this;
    b_BCM_EDSS_SW_STATE.EDSS_Driver_On_Off.phys = SW_STATE1; 
}

on sysvar sysvar::BCM::sv_EDSS_Passenger_On_Off {
    SW_STATE2 = @this;
    b_BCM_EDSS_SW_STATE.EDSS_Passenger_On_Off.phys = SW_STATE2; 
  
    setControlVisibility("Cluster","count_5s",1); //패널명, control name명, 1이면 보이는거/0이면 안보이게 하는거
    setControlVisibility("Cluster","count_5s_message",1); 
  
    if (@this == 1) { // 값이 1일 때 타이머 시작
        count5s = 0;
        BCM_cnt5s = 0;
        setTimer(EDSS_5sCnt, 1000);
    } else { // 값이 0일 때 타이머 종료
        cancelTimer(EDSS_5sCnt);
        count5s = 0;
        BCM_cnt5s = 0;
        @sysvar::BCM::sv_Count_5s = 0;
    }
}

on sysvar sysvar::BCM::sv_Wheel_Speed_FL {
    Speed_FL = @this;
    b_BCM_Wheel_Speed_FL.Wheel_Speed_FL.phys = Speed_FL; 
}

on sysvar sysvar::BCM::sv_Wheel_Speed_FR {
    Speed_FR = @this;
    b_BCM_Wheel_Speed_FR.Wheel_Speed_FR.phys = Speed_FR; 
}

on sysvar sysvar::BCM::sv_Wheel_Speed_RL {
    Speed_RL = @this;
    b_BCM_Wheel_Speed_RL.Wheel_Speed_RL.phys = Speed_RL; 
}

on sysvar sysvar::BCM::sv_Wheel_Speed_RR {
    Speed_RR = @this;
    b_BCM_Wheel_Speed_RR.Wheel_Speed_RR.phys = Speed_RR; 
}

on sysvar sysvar::BCM::sv_BCM_EDSS_CANCEL_SW {
    EDSS_CSW = @this;
    b_BCM_EDSS_CSW.BCM_EDSS_CANCEL_SW.phys = EDSS_CSW; 
}

on sysvar sysvar::BCM::sv_Seat_FL {
    Seat_FL = @this;
    b_BCM_Seat.Seat_FL.phys = Seat_FL; 
}

on sysvar sysvar::BCM::sv_Seat_FR {
    Seat_FR = @this;
    b_BCM_Seat.Seat_FR.phys = Seat_FR; 
}

on sysvar sysvar::BCM::sv_Seat_RL {
    Seat_RL = @this;
    b_BCM_Seat.Seat_RL.phys = Seat_RL; 
}

on sysvar sysvar::BCM::sv_Seat_RR {
    Seat_RR = @this;
    b_BCM_Seat.Seat_RR.phys = Seat_RR; 
}

on sysvar sysvar::BCM::sv_AirBag_state {
    AirBag_state = @this;
    b_BCM_AirBag_state.AirBag_state.phys = AirBag_state; 
}

on sysvar sysvar::BCM::sv_AirBag_Pos {
    AirBag_Pos = @this;
    b_BCM_AirBag_Pos.AirBag_Pos.phys = AirBag_Pos; 
}

on sysvar sysvar::BCM::sv_Str_Hold {
    Steering_Holding = @this;
    b_BCM_Steering_Holding.Str_Hold.phys = Steering_Holding; 
}

on sysvar sysvar::BCM::sv_Str_Pos {
    Steering_Pos = @this;
    b_BCM_Steering_Pos.Str_Pos.phys = Steering_Pos; 
}

on sysvar sysvar::BCM::sv_Rear_Vehicle_state {
    Rear_Vehicle_State = @this;
    b_BCM_Rear_Vehicle_State.Rear_Vehicle_state.phys = Rear_Vehicle_State; 
    //여기에 첫화면 등록할까..
}

on sysvar sysvar::BCM::sv_Side_Road_State {
    Side_Road_State = @this;
    b_BCM_Side_Road_State.Side_Road_State.phys = Side_Road_State; 
}

on timer moving
{ // 1. 측후방 ON, 갓길 OFF -> 차선 유지
  if(Rear_Vehicle_State == 1 && Side_Road_State==0) {
    if (@sysvar::BCM::moving_car<7) {
      @sysvar::BCM::moving_car++;
      flag = 1;
    } 
  } 
  
  // 2. 측후방 OFF, 갓길 OFF ->차선 이동
  else if ((0<flag) && (flag<17) && Rear_Vehicle_State == 0 && Side_Road_State==0) {
    if (@sysvar::BCM::moving_car<12) {
        @sysvar::BCM::moving_car++;
    }
    flag++;
  }
  
  // 3. 측후방 OFF, 갓길 ON ->차선 이동
  else if (flag==17 && Rear_Vehicle_State == 0 && Side_Road_State==0) {
    if (@sysvar::BCM::moving_car<16) {
        @sysvar::BCM::moving_car++;
        
    }
  }
  // 4. 측후방 OFF, 갓길 ON ->정차
  else if (Rear_Vehicle_State == 0 && Side_Road_State==1) {
    if (@sysvar::BCM::moving_car<19) {
        @sysvar::BCM::moving_car++;
    }
  }
}

////////연습////////////////
on sysvar sysvar::BCM::pra_edss_act {
    a = @this;
    b_VCU_IVI_Msg.EDSS_Act.phys = a; 
}

on sysvar sysvar::BCM::pra_ecall_req {
    b = @this;
    b_VCU_IVI_Msg.ECall_Req.phys = a; 
}