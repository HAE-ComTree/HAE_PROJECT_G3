/*@!Encoding:949*/

variables
{
    message IVI_EDSS_CSW b_IVI_EDSS_CSW; int EDSS_CSW; // 주기적으로 송신할 메시지 정의
    
    message IVI_NM_Flag b_IVI_NM_Flag;
  
    int NM_flag = 0;
    int IGN1_flag = 0;
    int Wakeup = 0;
  
    msTimer IVIMessageTimer;      // 송신용 타이머
}

on timer IVIMessageTimer
{
  output(b_IVI_NM_Flag);
  output(b_IVI_EDSS_CSW);
}

/* GW_NM_BCM 메시지 핸들러 */
on message GW_NM_IVI
{
    if (this.NmSleepCmd_IVI == 0) 
    {
        NM_flag = 0; 
    }
    else if (this.NmSleepCmd_IVI == 1)
    {
        NM_flag = 1; 
    }

    checkWakeupCondition();
}

/* VCU_IGN1 메시지 핸들러 */
on message VCU_IGN1
{
    if (this.IGN_State == 0) 
    {
        IGN1_flag = 0;
    }
    else if (this.IGN_State == 1)
    {
        IGN1_flag = 1; 
    }

    checkWakeupCondition();
}

/* Wakeup 상태 확인 함수 */
void checkWakeupCondition()
{
    if (IGN1_flag == 1 && NM_flag == 1) 
    {
        if (Wakeup == 0) // Wakeup이 처음으로 1이 되었을 때
        {
            Wakeup = 1;
            b_IVI_NM_Flag.NmSleepFlag_IVI.phys = 1;
        }
    }
    else 
    {
        if (Wakeup == 1) // Wakeup이 0으로 변경될 때
        {
            Wakeup = 0;
            b_IVI_NM_Flag.NmSleepFlag_IVI.phys = 0;
        }
    }
}

/* ------------------------------------------------------------------ */

/* 초기화 */
on start
{   
    @sysvar::IVI::sv_IVI_EDSS_CANCEL_SW=0;
    
    b_IVI_NM_Flag.NmSleepFlag_IVI.phys = 0;
  
    b_IVI_EDSS_CSW.IVI_EDSS_CANCEL_SW.phys = 0; EDSS_CSW = 0; 
  
    setTimerCyclic(IVIMessageTimer, 0, 100); // 100ms 주기로 송신
}

/* ----------------------------------------------- */

on sysvar sysvar::IVI::sv_IVI_EDSS_CANCEL_SW 
{
    EDSS_CSW = @this;
    b_IVI_EDSS_CSW.IVI_EDSS_CANCEL_SW.phys = EDSS_CSW; 
}

on message VCU_IVI_Msg {
  
  if (this.EDSS_Act.phys == 1 && this.ECall_Req.phys == 0) {
    @sysvar::IVI::sv_stop_message = 0;
    setControlVisibility("stop_situation","stop_message",1); 
  } 
  
  else if (this.EDSS_Act.phys == 1 && this.ECall_Req.phys == 1) {
    @sysvar::IVI::sv_stop_message = 1;
    setControlVisibility("stop_situation","stop_message",1); 
  } 
  
  else {
    setControlVisibility("stop_situation","stop_message",0); 
  }
}