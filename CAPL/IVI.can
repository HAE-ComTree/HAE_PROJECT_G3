/*@!Encoding:949*/

variables
{
    message IVI_EDSS_CSW b_IVI_EDSS_CSW; int EDSS_CSW; // 주기적으로 송신할 메시지 정의
    
    message IVI_NM_Flag b_IVI_NM_Flag;
  
    int NM_flag = 0;
    int IGN1_flag = 0;
    int Wakeup = 0;
  
    msTimer IVIMessageTimer;      // 송신용 타이머
    
    int call_flag = 0;
    
    //주변 알림
    msTimer surrounding;
}

on timer IVIMessageTimer
{
  output(b_IVI_NM_Flag);
  output(b_IVI_EDSS_CSW);
}

on timer surrounding
{
  //주변 차량 알림
  if ($VCU_IVI_Msg::EDSS_Act==1 && $VCU_IVI_Msg::ECall_Req==1) {
      if (@sysvar::BCM::moving_car == 20) {
          @sysvar::BCM::moving_car++;
      } else if (@sysvar::BCM::moving_car == 21) {
          @sysvar::BCM::moving_car--;
      } 
  }
}

/* GW_NM_BCM 메시지 핸들러 */
on message GW_NM_IVI
{
    if (this.NmSleepCmd_IVI == 0) 
    {
        NM_flag = 0; 
    }
    else if (this.NmSleepCmd_IVI == 1)
    {
        NM_flag = 1; 
    }

    checkWakeupCondition();
}

/* VCU_IGN1 메시지 핸들러 */
on message VCU_IGN1
{
    if (this.IGN_State == 0) 
    {
        IGN1_flag = 0;
    }
    else if (this.IGN_State == 1)
    {
        IGN1_flag = 1; 
    }

    checkWakeupCondition();
}

/* Wakeup 상태 확인 함수 */
void checkWakeupCondition()
{
    if (IGN1_flag == 1 && NM_flag == 1) 
    {
        if (Wakeup == 0) // Wakeup이 처음으로 1이 되었을 때
        {
            Wakeup = 1;
            b_IVI_NM_Flag.NmSleepFlag_IVI.phys = 1;
        }
    }
    else 
    {
        if (Wakeup == 1) // Wakeup이 0으로 변경될 때
        {
            Wakeup = 0;
            b_IVI_NM_Flag.NmSleepFlag_IVI.phys = 0;
        }
    }
}

/* ------------------------------------------------------------------ */

/* 초기화 */
on start
{   
    @sysvar::IVI::sv_IVI_EDSS_CANCEL_SW=0;
    
    b_IVI_NM_Flag.NmSleepFlag_IVI.phys = 0;
  
    b_IVI_EDSS_CSW.IVI_EDSS_CANCEL_SW.phys = 0; EDSS_CSW = 0; 
  
    setTimerCyclic(IVIMessageTimer, 0, 100); // 100ms 주기로 송신
    setTimerCyclic(surrounding, 0, 100); //주변 차량
  
    call_flag = 0;
}

/* ----------------------------------------------- */

on sysvar sysvar::IVI::sv_IVI_EDSS_CANCEL_SW 
{
    EDSS_CSW = @this;
    b_IVI_EDSS_CSW.IVI_EDSS_CANCEL_SW.phys = EDSS_CSW; 
}

on message GW_TCU_Gear_Data {
  
  if (this.TCU_GearType.phys == 0) {
    @sysvar::IVI::sv_gear = 0;
  }
  else if (this.TCU_GearType.phys == 1) {
    @sysvar::IVI::sv_gear = 1;
  }
  else if (this.TCU_GearType.phys == 2) {
    @sysvar::IVI::sv_gear = 2;
  }
  else if (this.TCU_GearType.phys == 3) {
    @sysvar::IVI::sv_gear = 3;
  }
  else if (this.TCU_GearType.phys == 4) {
    @sysvar::IVI::sv_gear = 4;
  }
  else if (this.TCU_GearType.phys == 5) {
    @sysvar::IVI::sv_gear = 5;
  }
}

on message VCU_IVI_Msg {
  
  if (this.EDSS_Act.phys == 1) {
    
    @sysvar::IVI::sv_EDSS_state = 1;
    
    if (this.ECall_Req.phys == 0) {
      @sysvar::IVI::sv_stop_message = 0;
      setControlVisibility("stop_situation","stop_message",1); 
    } 
    else if (call_flag < 20 && this.ECall_Req.phys == 1) {
      @sysvar::IVI::sv_stop_message = 1;  //정차가 완료되었습니다.
      call_flag++;
    } 
    else if (call_flag == 20 && this.ECall_Req.phys == 1) {
      @sysvar::IVI::sv_stop_message = 2;   //신고가 접수되었습니다.
    } 
  }
  else {
    @sysvar::IVI::sv_EDSS_state = 0;
    setControlVisibility("stop_situation","stop_message",0); 
  }
}

on message Sever_119_Call {
  if (this.Call_119.phys == 1) {
    @sysvar::DMS::sv_DMS_CautionLv = 5;
  }
}