/*@!Encoding:949*/

variables
{
    message DMS_Driver_State b_DMS_Driver_State; int Driver_State;
  
    message DMS_NM_Flag b_DMS_NM_Flag;
  
    int NM_flag = 0;
    int IGN1_flag = 0;
    int Wakeup = 0;
  
    msTimer DMSMessageTimer;      // DMS_Driver_State 송신용 타이머
}

on timer DMSMessageTimer
{ 
  output(b_DMS_NM_Flag);
  output(b_DMS_Driver_State);
}

/* GW_NM_BCM 메시지 핸들러 */
on message GW_NM_DMS
{
    if (this.NmSleepCmd_DMS.phys == 0) 
    {
        NM_flag = 0; 
    }
    else if (this.NmSleepCmd_DMS.phys == 1)
    {
        NM_flag = 1; 
    }

    checkWakeupCondition();
}

/* VCU_IGN1 메시지 핸들러 */
on message VCU_IGN1
{
    if (this.IGN_State.phys == 0) 
    {
        IGN1_flag = 0;
    }
    else if (this.IGN_State.phys == 1)
    {
        IGN1_flag = 1; 
    }

    checkWakeupCondition();
}


/* Wakeup 상태 확인 함수 */
void checkWakeupCondition()
{
    if (IGN1_flag == 1 && NM_flag == 1) 
    {
        if (Wakeup == 0) // Wakeup이 처음으로 1이 되었을 때
        {
            Wakeup = 1;
            b_DMS_NM_Flag.NmSleepFlag_DMS.phys = 1;
        
        }
    }
    else 
    {
        if (Wakeup == 1) // Wakeup이 0으로 변경될 때
        {
            Wakeup = 0;
            b_DMS_NM_Flag.NmSleepFlag_DMS.phys = 0;
        }
    }
}


/* 초기화 */
on start
{ 
    @sysvar::DMS::sv_DMS_CautionLv = 0;
    @sysvar::DMS::sv_warning_message = 0;
    @sysvar::DMS::sv_warning_sound = 0;
    @sysvar::DMS::sv_warning_steering = 0;
    @sysvar::DMS::sv_warning_belt = 0;
  
    b_DMS_NM_Flag.NmSleepFlag_DMS.phys = 0;
  
    b_DMS_Driver_State.DMS_CautionLv.phys = 0; Driver_State = 0;
  
    setTimerCyclic(DMSMessageTimer, 0, 100); // 100ms 주기로 송신
}

on sysvar sysvar::DMS::sv_DMS_CautionLv
{
    Driver_State = @this;
    b_DMS_Driver_State.DMS_CautionLv.phys = Driver_State;
  
    
}

on message DMS_Driver_State {

    if (@sysvar::DMS::sv_DMS_CautionLv == 2) {
        @sysvar::DMS::sv_warning_message = 1; //경고 메세지
        @sysvar::DMS::sv_warning_sound = 0;// 오디오 경보
        @sysvar::DMS::sv_warning_steering = 0;// 핸들 진동
        @sysvar::DMS::sv_warning_belt = 0;// 벨트 조임
    } 
    else if (@sysvar::DMS::sv_DMS_CautionLv == 3) {
        @sysvar::DMS::sv_warning_message = 2; //경고 메세지
        @sysvar::DMS::sv_warning_sound = 1;// 오디오 경보
        @sysvar::DMS::sv_warning_steering = 1;// 핸들 진동
        @sysvar::DMS::sv_warning_belt = 1;// 벨트 조임
      
    } 
    else {
        @sysvar::DMS::sv_warning_message = 0; //경고 메세지
        @sysvar::DMS::sv_warning_sound = 0; // 오디오 경보
        @sysvar::DMS::sv_warning_steering = 0;// 핸들 진동
        @sysvar::DMS::sv_warning_belt = 0;// 벨트 조임
    }
}