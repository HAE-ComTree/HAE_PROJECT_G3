/*@!Encoding:65001*/
includes
{
  
}

variables
{
  msTimer tmrEPB;
  
  message CAN1::EPB_Press_Data P_EPB_Press_Data;
  message CAN1::EPB_State_Data P_EPB_State_Data;
  message CAN1::EPB_NM_Flag P_EPB_NM_Flag;
}

on timer tmrEPB {
  output(P_EPB_NM_Flag);
  output(P_EPB_Press_Data);
  output(P_EPB_State_Data);
}

on start {
  $CAN1::EPB::EPB_State_Data::EPB_ACT=0;

  setTimerCyclic(tmrEPB, 0, 20);
  
  $CAN1::EPB_NM_Flag::EPB_Flag.phys=0;
  $CAN1::EPB_State_Data::EPB_ACT.phys=0;
  $CAN1::EPB_Press_Data::EPB_CylinderPress.phys=0;
  $CAN1::EPB_Press_Data::EPB_CylinderState.phys=0;
}

void activeEPB() {
  $CAN1::EPB::EPB_State_Data::EPB_ACT=1;
  
  $CAN1::EPB::EPB_Press_Data::EPB_CylinderState=1;
  $CAN1::EPB::EPB_Press_Data::EPB_CylinderPress=350;
  $CAN1::EPB::EPB_Press_Data::EPB_CylinderState=0;
}

void deactivateEPB() {
  $CAN1::EPB::EPB_State_Data::EPB_ACT=0;
  
  $CAN1::EPB::EPB_Press_Data::EPB_CylinderState=1;
  $CAN1::EPB::EPB_Press_Data::EPB_CylinderPress=0;
  $CAN1::EPB::EPB_Press_Data::EPB_CylinderState=0;
}

on message GW_SCC_E_stop {
  if(this.CF_Estop == 1) {
    activeEPB();
  }
  else { deactivateEPB(); }
}

on message GW_SSC_CmdSta {
  if(this.SCC_StopStaSig == 1){
    activeEPB();
  }
}
